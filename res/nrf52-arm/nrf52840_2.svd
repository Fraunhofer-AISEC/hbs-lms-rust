# nrf52840 register map
Vendor: Nordic Semiconductor; Series: nrf52; File version: 1
nRF52840 reference description for radio MCU with ARM 32-bit Cortex-M4 Microcontroller
CPU: CM4 r0p1, little endian, MPU, FPU, 3 interrupt priority bits
Registers are 32-bit, read-write, reset 0x0 unless marked. A register's access mark holds for its fields unless they carry their own. Offsets are from the block's base; lines under a group give offsets from that group; [hi:lo] are bit positions; {n}, {i} and the like mark numbered series; 'fields as' and 'values as' point back to an identical list; <NAME> marks a mode.

## Memory map
0x10000000 FICR size 0x1000 — Factory information configuration registers
0x10001000 UICR size 0x1000 — User information configuration registers
0x40000000 CLOCK size 0x1000 — Clock control
0x40000000 POWER size 0x1000 — Power control
0x40001000 RADIO size 0x1000 — 2.4 GHz radio
0x40002000 UART0 size 0x1000 — Universal Asynchronous Receiver/Transmitter
0x40002000 UARTE0 size 0x1000 — UART with EasyDMA 0
0x40003000 SPI0 size 0x1000 — Serial Peripheral Interface 0
0x40003000 SPIM0 size 0x1000 — Serial Peripheral Interface Master with EasyDMA 0
0x40003000 SPIS0 size 0x1000 — SPI Slave 0
0x40003000 TWI0 size 0x1000 — I2C compatible Two-Wire Interface 0
0x40003000 TWIM0 size 0x1000 — I2C compatible Two-Wire Master Interface with EasyDMA 0
0x40003000 TWIS0 size 0x1000 — I2C compatible Two-Wire Slave Interface with EasyDMA 0
0x40004000 SPI1 size 0x1000 — Serial Peripheral Interface 1
0x40004000 SPIM1 size 0x1000 — Serial Peripheral Interface Master with EasyDMA 1
0x40004000 SPIS1 size 0x1000 — SPI Slave 1
0x40004000 TWI1 size 0x1000 — I2C compatible Two-Wire Interface 1
0x40004000 TWIM1 size 0x1000 — I2C compatible Two-Wire Master Interface with EasyDMA 1
0x40004000 TWIS1 size 0x1000 — I2C compatible Two-Wire Slave Interface with EasyDMA 1
0x40005000 NFCT size 0x1000 — NFC-A compatible radio
0x40006000 GPIOTE size 0x1000 — GPIO Tasks and Events
0x40007000 SAADC size 0x1000 — Successive approximation register (SAR) analog-to-digital converter
0x40008000 TIMER0 size 0x1000 — Timer/Counter 0
0x40009000 TIMER1 size 0x1000 — Timer/Counter 1
0x4000A000 TIMER2 size 0x1000 — Timer/Counter 2
0x4000B000 RTC0 size 0x1000 — Real time counter 0
0x4000C000 TEMP size 0x1000 — Temperature Sensor
0x4000D000 RNG size 0x1000 — Random Number Generator
0x4000E000 ECB size 0x1000 — AES ECB Mode Encryption
0x4000F000 AAR size 0x1000 — Accelerated Address Resolver
0x4000F000 CCM size 0x1000 — AES CCM Mode Encryption
0x40010000 WDT size 0x1000 — Watchdog Timer
0x40011000 RTC1 size 0x1000 — Real time counter 1
0x40012000 QDEC size 0x1000 — Quadrature Decoder
0x40013000 COMP size 0x1000 — Comparator
0x40013000 LPCOMP size 0x1000 — Low Power Comparator
0x40014000 EGU0 size 0x1000 — Event Generator Unit 0
0x40014000 SWI0 size 0x1000 — Software interrupt 0
0x40015000 EGU1 size 0x1000 — Event Generator Unit 1
0x40015000 SWI1 size 0x1000 — Software interrupt 1
0x40016000 EGU2 size 0x1000 — Event Generator Unit 2
0x40016000 SWI2 size 0x1000 — Software interrupt 2
0x40017000 EGU3 size 0x1000 — Event Generator Unit 3
0x40017000 SWI3 size 0x1000 — Software interrupt 3
0x40018000 EGU4 size 0x1000 — Event Generator Unit 4
0x40018000 SWI4 size 0x1000 — Software interrupt 4
0x40019000 EGU5 size 0x1000 — Event Generator Unit 5
0x40019000 SWI5 size 0x1000 — Software interrupt 5
0x4001A000 TIMER3 size 0x1000 — Timer/Counter 3
0x4001B000 TIMER4 size 0x1000 — Timer/Counter 4
0x4001C000 PWM0 size 0x1000 — Pulse width modulation unit 0
0x4001D000 PDM size 0x1000 — Pulse Density Modulation (Digital Microphone) Interface
0x4001E000 ACL size 0x1000 — Access control lists
0x4001E000 NVMC size 0x1000 — Non Volatile Memory Controller
0x4001F000 PPI size 0x1000 — Programmable Peripheral Interconnect
0x40020000 MWU size 0x1000 — Memory Watch Unit
0x40021000 PWM1 size 0x1000 — Pulse width modulation unit 1
0x40022000 PWM2 size 0x1000 — Pulse width modulation unit 2
0x40023000 SPI2 size 0x1000 — Serial Peripheral Interface 2
0x40023000 SPIM2 size 0x1000 — Serial Peripheral Interface Master with EasyDMA 2
0x40023000 SPIS2 size 0x1000 — SPI Slave 2
0x40024000 RTC2 size 0x1000 — Real time counter 2
0x40025000 I2S size 0x1000 — Inter-IC Sound
0x40026000 FPU size 0x1000
0x40027000 USBD size 0x1000 — Universal serial bus device
0x40028000 UARTE1 size 0x1000 — UART with EasyDMA 1
0x40029000 QSPI size 0x1000 — External flash interface
0x4002D000 PWM3 size 0x1000 — Pulse width modulation unit 3
0x4002F000 SPIM3 size 0x1000 — Serial Peripheral Interface Master with EasyDMA 3
0x50000000 P0 size 0x1000 — GPIO Port 1
0x50000300 P1 size 0x1000 — GPIO Port 2
0x5002A000 CC_HOST_RGF size 0x2000 — CRYPTOCELL HOST_RGF interface
0x5002A000 CRYPTOCELL size 0x2000 — ARM TrustZone CryptoCell register interface

## Interrupts
0 POWER_CLOCK (CLOCK, POWER)
1 RADIO
2 UARTE0_UART0 (UART0, UARTE0)
3 SPIM0_SPIS0_TWIM0_TWIS0_SPI0_TWI0 (SPI0, SPIM0, SPIS0, TWI0, TWIM0, TWIS0)
4 SPIM1_SPIS1_TWIM1_TWIS1_SPI1_TWI1 (SPI1, SPIM1, SPIS1, TWI1, TWIM1, TWIS1)
5 NFCT
6 GPIOTE
7 SAADC
8 TIMER0
9 TIMER1
10 TIMER2
11 RTC0
12 TEMP
13 RNG
14 ECB
15 CCM_AAR (AAR, CCM)
16 WDT
17 RTC1
18 QDEC
19 COMP_LPCOMP (COMP, LPCOMP)
20 SWI0_EGU0 (EGU0, SWI0)
21 SWI1_EGU1 (EGU1, SWI1)
22 SWI2_EGU2 (EGU2, SWI2)
23 SWI3_EGU3 (EGU3, SWI3)
24 SWI4_EGU4 (EGU4, SWI4)
25 SWI5_EGU5 (EGU5, SWI5)
26 TIMER3
27 TIMER4
28 PWM0
29 PDM
32 MWU
33 PWM1
34 PWM2
35 SPIM2_SPIS2_SPI2 (SPI2, SPIM2, SPIS2)
36 RTC2
37 I2S
38 FPU
39 USBD
40 UARTE1
41 QSPI
42 CRYPTOCELL
45 PWM3
47 SPIM3

## Further device data
ExampleStackSize=2048, ExampleHeapSize=2048, MaxInterrupts=112

## Licence text in the file
Copyright (c) 2010 - 2018, Nordic Semiconductor ASA . All rights reserved. . Redistribution and use in source and binary forms, with or without modification, are permitted provided that the following conditions are met: . 1. Redistributions of source code must retain the above copyright notice, this list of conditions and the following disclaimer. . 2. Redistributions in binary form, except as embedded into a Nordic. Semiconductor ASA integrated circuit in a product or a software update for such product, must reproduce the above copyright notice, this list of conditions and the following disclaimer in the documentation and/or other materials provided with the distribution. . 3. Neither the name of Nordic Semiconductor ASA nor the names of its contributors may be used to endorse or promote products derived from this software without specific prior written permission. . 4. This software, with or without modification, must only be used with a. Nordic Semiconductor ASA integrated circuit. . 5. Any software provided in binary form under this license must not be reverse engineered, decompiled, modified and/or disassembled. . THIS SOFTWARE IS PROVIDED BY NORDIC SEMICONDUCTOR ASA "AS IS" AND ANY. EXPRESS OR IMPLIED WARRANTIES, INCLUDING, BUT NOT LIMITED TO, THE IMPLIED. WARRANTIES OF MERCHANTABILITY, NONINFRINGEMENT, AND FITNESS FOR A. PARTICULAR PURPOSE ARE DISCLAIMED. IN NO EVENT SHALL NORDIC SEMICONDUCTOR. ASA OR CONTRIBUTORS BE LIABLE FOR ANY DIRECT, INDIRECT, INCIDENTAL, SPECIAL, EXEMPLARY, OR CONSEQUENTIAL DAMAGES (INCLUDING, BUT NOT LIMITED. TO, PROCUREMENT OF SUBSTITUTE GOODS OR SERVICES; LOSS OF USE, DATA, OR. PROFITS; OR BUSINESS INTERRUPTION) HOWEVER CAUSED AND ON ANY THEORY OF. LIABILITY, WHETHER IN CONTRACT, STRICT LIABILITY, OR TORT (INCLUDING. NEGLIGENCE OR OTHERWISE) ARISING IN ANY WAY OUT OF THE USE OF THIS. SOFTWARE, EVEN IF ADVISED OF THE POSSIBILITY OF SUCH DAMAGE.
